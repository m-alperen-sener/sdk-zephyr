## tests/bluetooth/adv/testcase.yaml
```yaml
tests:
  bluetooth.adv:
    platform_allow:
      - nrf52_bsim
      - nrf52840dk/nrf52840
    tags: bluetooth
    slow: true
    timeout: 360
    integration_platforms:
      - nrf52840dk/nrf52840
```
